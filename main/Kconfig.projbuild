## main/Kconfig.projbuild
```kconfig
menu "Project hardware"

    choice USER_DISPLAY_PROFILE
        prompt "Display profile"
        default USER_DISPLAY_NONE

        config USER_DISPLAY_ST7796S
            bool "ST7796S 480x320 3.5in - colorful UI"

        config USER_DISPLAY_ST7796S_TEST
            bool "ST7796S 480x320 - test UI"


        config USER_DISPLAY_LVGL_TDISPLAY_S3
		bool "LVGL T-Display S3 - LilyGO LVGL UI"

        config USER_DISPLAY_ST7789_GMT020
            bool "ST7789 240x320 - GMT020-02-7P"

        config USER_DISPLAY_ST7789_HW657A
            bool "ST7789 170x320 - HW657A - Simple UI"

        config USER_DISPLAY_NONE
            bool "No display"

    endchoice

config USER_SEN54_SDA_GPIO
    int
    default 4 if USER_DISPLAY_ST7796S
    default 4 if USER_DISPLAY_ST7796S_TEST
    default 13 if USER_DISPLAY_ST7789_GMT020
    default 13 if USER_DISPLAY_ST7789_HW657A
    default 18 if USER_DISPLAY_LVGL_TDISPLAY_S3
    default 4

config USER_SEN54_SCL_GPIO
    int
    default 5 if USER_DISPLAY_ST7796S
    default 5 if USER_DISPLAY_ST7796S_TEST
    default 14 if USER_DISPLAY_ST7789_GMT020
    default 14 if USER_DISPLAY_ST7789_HW657A
    default 17 if USER_DISPLAY_LVGL_TDISPLAY_S3
    default 5

config USER_SEN54_I2C_PORT
    int
    default 0 if USER_DISPLAY_LVGL_TDISPLAY_S3
    default 0

# CST816 touch (LilyGO T-Display-S3 only)
config USER_TOUCH_CST816
    bool "Enable CST816 touch controller"
    default y if USER_DISPLAY_LVGL_TDISPLAY_S3
    default n

config USER_TOUCH_CST816_I2C_PORT
    int
    default 0

config USER_TOUCH_CST816_SDA_GPIO
    int
    default 18

config USER_TOUCH_CST816_SCL_GPIO
    int
    default 17

config USER_TOUCH_CST816_ADDR
    hex
    default 0x15

config USER_TOUCH_CST816_RST_GPIO
    int
    default 21

config USER_TOUCH_CST816_INT_GPIO
    int
    default 16

config USER_SENSOR_DS18B20
    bool
    default y if USER_DISPLAY_ST7796S
    default y if USER_DISPLAY_ST7796S_TEST
    default n if USER_DISPLAY_ST7789_GMT020
    default n if USER_DISPLAY_ST7789_HW657A
    default n if USER_DISPLAY_LVGL_TDISPLAY_S3
    default n

# MS/TP RS-485 transceiver (MAX485). GPIO5/16/17 collide with the
# T-Display-S3 board's TFT reset and touch I2C pins, so that profile
# uses free header pins instead.
config USER_MSTP_UART_TX_GPIO
    int
    default 1 if USER_DISPLAY_LVGL_TDISPLAY_S3
    default 17

config USER_MSTP_UART_RX_GPIO
    int
    default 2 if USER_DISPLAY_LVGL_TDISPLAY_S3
    default 16

config USER_MSTP_UART_DE_GPIO
    int
    default 3 if USER_DISPLAY_LVGL_TDISPLAY_S3
    default 5

endmenu
```
